## boards/paperone/Kconfig.paperone
```kconfig
# Copyright (c) 2024 STMicroelectronics
# SPDX-License-Identifier: Apache-2.0

config BOARD_PAPERONE
	select SOC_STM32F413XX
```

## boards/paperone/board.yml
```yaml
board:
  name: paperone
  full_name: HSW Paperone
  vendor: hsw
  socs:
    - name: stm32f413xx
```
